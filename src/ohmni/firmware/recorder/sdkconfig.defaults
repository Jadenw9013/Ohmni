## src/ohmni/firmware/recorder/sdkconfig.defaults
```kconfig
CONFIG_IDF_TARGET="esp32"
CONFIG_ESPTOOLPY_FLASHSIZE_4MB=y
CONFIG_FATFS_LFN_HEAP=y
CONFIG_FATFS_MAX_LFN=64
CONFIG_FREERTOS_HZ=1000
CONFIG_COMPILER_OPTIMIZATION_SIZE=y
```
